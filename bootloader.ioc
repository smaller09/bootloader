# file: bootloader.ioc
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Mcu.Family=STM32F1
Mcu.Name=STM32F103C(8-B)Tx
Mcu.Package=LQFP48
NVIC.PriorityGroup=NVIC_PRIORITYGROUP_4
ProjectManager.HeapSize=0x200
ProjectManager.StackSize=0x400
ProjectManager.TargetToolchain=Makefile
RCC.AHBFreq_Value=36000000
RCC.APB1Freq_Value=36000000
RCC.APB1TimFreq_Value=36000000
RCC.APB2Freq_Value=36000000
RCC.APB2TimFreq_Value=36000000
RCC.HCLKFreq_Value=36000000
RCC.PLLMUL=RCC_PLL_MUL9
RCC.SYSCLKFreq_VALUE=36000000
RCC.SYSCLKSource=RCC_SYSCLKSOURCE_PLLCLK
RCC.USBFreq_Value=36000000
board=custom

// file: Core/Src/main.c
/* USER CODE BEGIN Header */
/**
 ******************************************************************************
 * @file           : main.c
 * @brief          : Main program body
 ******************************************************************************
 * @attention
 *
 * Copyright (c) 2023 STMicroelectronics.
 * All rights reserved.
 *
 * This software is licensed under terms that can be found in the LICENSE file
 * in the root directory of this software component.
 * If no LICENSE file comes with this software, it is provided AS-IS.
 *
 ******************************************************************************
 */
/* USER CODE END Header */
#include "main.h"

/* USER CODE BEGIN Includes */
#include "stk500.h"
#include "stm32f1xx_ll_flash.h"

/* USER CODE END Includes */

/* USER CODE BEGIN PTD */
typedef void (*p_APP)(void);
#define DEBUG
/* USER CODE END PTD */

/* USER CODE BEGIN PD */
#define OPTIBOOT_MAJVER 4
#define OPTIBOOT_MINVER 5

#define SIGNATURE_0 0x1E
#define SIGNATURE_1 0x55 // 0x97
#define SIGNATURE_2 0xAA // 0x02

#define SIGNATURE_3 0x97
#define SIGNATURE_4 0x02

#define APP_ADDR 0x08000800

#define FLASH_TOP 0x08020000
/* USER CODE END PD */

/* USER CODE BEGIN PV */
union
{
    uint8_t buff_8[1024];
    uint16_t buff_16[512];
} prog_data;

uint32_t LED = 0;

__IO uint32_t *G_SR = (__IO uint32_t *)(USART2_BASE); // for getch
__IO uint32_t *G_DR = (__IO uint32_t *)(USART2_BASE + 4);

__IO uint32_t *P_SR = (__IO uint32_t *)(USART3_BASE); // for putch
__IO uint32_t *P_DR = (__IO uint32_t *)(USART3_BASE + 4);

/* USER CODE END PV */

void SystemClock_Config(void);
/* USER CODE BEGIN PFP */
void runApp();
uint8_t getch(void);
void putch(uint8_t byte);
uint32_t verifySpace(void);
void bgetNch(uint32_t count);
void system_init(void);
/* USER CODE END PFP */

int main(void)
{

    /* MCU Configuration--------------------------------------------------------*/

    /* Reset of all peripherals, Initializes the Flash interface and the Systick. */
    LL_APB2_GRP1_EnableClock(LL_APB2_GRP1_PERIPH_AFIO);
    LL_APB1_GRP1_EnableClock(LL_APB1_GRP1_PERIPH_PWR);

    /* System interrupt init*/
    NVIC_SetPriorityGrouping(NVIC_PRIORITYGROUP_4);

    /* SysTick_IRQn interrupt configuration */
    NVIC_SetPriority(SysTick_IRQn, NVIC_EncodePriority(NVIC_GetPriorityGrouping(), 15, 0));

    /* Configure the system clock */
    SystemClock_Config();

    /* USER CODE BEGIN SysInit */
    system_init();
    /* USER CODE END SysInit */

    /* Initialize all configured peripherals */
    /* USER CODE BEGIN 2 */

    LL_Flash_Unlock();

    if (LL_RCC_IsActiveFlag_SFTRST() == 0)
    {
        LL_mDelay(150);
        if (0xF0 != ((uint8_t)(GPIOA->IDR) & 0xF1))
        {
            runApp();
        }
    }
    LL_RCC_ClearResetFlags();
    /*
        G_SR = (__IO uint32_t *)(USART2_BASE);
        G_DR = (__IO uint32_t *)(USART2_BASE + 4);
        P_SR = (__IO uint32_t *)(USART3_BASE);
        P_DR = (__IO uint32_t *)(USART3_BASE + 4);
    */
    uint8_t ch = 0;
    uint8_t lastCh = 0;
    uint32_t NotSynced = 1;
    uint32_t address = 0;
    uint32_t length;

    LED = 1;
    /* USER CODE END 2 */

    /* Infinite loop */
    while (1)
    {

/* USER CODE BEGIN 3 */
#ifdef DEBUG
        uint32_t Port = 1;
#endif
        while (NotSynced)
        {

            if (USART2->SR & USART_SR_RXNE)
            {
                ch = USART2->DR;
#ifdef DEBUG
                Port = 0;
#endif
            }
#ifdef DEBUG
            if (USART1->SR & USART_SR_RXNE)
            {
                ch = USART1->DR;
                Port = 1;
            }
#endif
            if ((lastCh == STK_GET_SYNC) && (ch == CRC_EOP))
            {
                NotSynced = 0;
                break;
            }
            lastCh = ch;
        }
#ifdef DEBUG
        if (Port == 0)
        {
            G_SR = (__IO uint32_t *)(USART2_BASE);
            G_DR = (__IO uint32_t *)(USART2_BASE + 4);
            P_SR = (__IO uint32_t *)(USART3_BASE);
            P_DR = (__IO uint32_t *)(USART3_BASE + 4);
        }
#endif
        ch = getch();
        switch (ch)
        {
        case STK_GET_PARAMETER:
            lastCh = getch();
            NotSynced = verifySpace();
            if (lastCh == 0x82)
            {
                putch(OPTIBOOT_MINVER);
            }
            else if (lastCh == 0x81)
            {
                putch(OPTIBOOT_MAJVER);
            }
            else
                putch(0x03);
            break;

        case STK_SET_DEVICE:
            bgetNch(20);
            NotSynced = verifySpace();
            break;

        case STK_SET_DEVICE_EXT:
            bgetNch(5);
            NotSynced = verifySpace();
            break;

        case STK_LOAD_ADDRESS:
            address = getch();
            address = (address & 0xff) | (getch() << 8);
            address <<= 1;
            address += 0x08000000;
            NotSynced = verifySpace();
            break;

        case STK_UNIVERSAL:
            bgetNch(4);
            NotSynced = verifySpace();
            putch(0x00);
            break;

        case STK_PROG_PAGE:
        {

            __IO uint16_t *progAddress = (uint16_t *)address;

            length = getch() << 8; /* getlen() */
            length |= getch();
            getch(); // discard flash/eeprom byte
            // While that is going on, read in page contents
            uint32_t count = length;
            uint8_t *bufPtr = prog_data.buff_8;
            do
            {
                *bufPtr++ = getch();
            } while (--count);

            count = length + 1;
            count >>= 1;
            NotSynced = verifySpace();

            if (((uint32_t)progAddress < FLASH_TOP) && ((uint32_t)progAddress >= APP_ADDR))
            {

                if (((uint32_t)progAddress & 0x000003FF) == 0)
                {
                    // At page start so erase it
                    // FLASH_ClearFlag(FLASH_FLAG_EOP | FLASH_FLAG_PGERR | FLASH_FLAG_WRPRTERR);
                    // FLASH_ErasePage((uint32_t)memAddress);
                    LL_Flash_PageErase((uint32_t)progAddress);
                }
                uint16_t *bufPtr = prog_data.buff_16;
                while (count)
                {
                    LL_FLASH_Program_TwoBtye(progAddress++, bufPtr++);
                    count--;
                }
            }
        }
        break;

        case STK_READ_PAGE:
        {
            __IO uint8_t *progAddress = (uint8_t *)(address);
            // READ PAGE - we only read flash
            length = getch() << 8; /* getlen() */
            length |= getch();
            getch();
            NotSynced = verifySpace();
            do
            {
                putch(*progAddress++);
            } while (--length);
        }
        break;

        case STK_READ_SIGN:
            NotSynced = verifySpace();
            putch(SIGNATURE_0);
            putch(SIGNATURE_1);
            putch(SIGNATURE_2);
            break;

        case STK_LEAVE_PROGMODE:
            runApp();
            break;

        default:
            NotSynced = verifySpace();
            break;
        }

        if (NotSynced)
            continue;
        putch(STK_OK);
    }
    /* USER CODE END 3 */
}

void SystemClock_Config(void)
{
    LL_FLASH_SetLatency(LL_FLASH_LATENCY_1);
    while (LL_FLASH_GetLatency() != LL_FLASH_LATENCY_1)
    {
    }
    LL_RCC_HSI_SetCalibTrimming(16);
    LL_RCC_HSI_Enable();

    /* Wait till HSI is ready */
    while (LL_RCC_HSI_IsReady() != 1)
    {
    }
    LL_RCC_PLL_ConfigDomain_SYS(LL_RCC_PLLSOURCE_HSI_DIV_2, LL_RCC_PLL_MUL_9);
    LL_RCC_PLL_Enable();

    /* Wait till PLL is ready */
    while (LL_RCC_PLL_IsReady() != 1)
    {
    }
    LL_RCC_SetAHBPrescaler(LL_RCC_SYSCLK_DIV_1);
    LL_RCC_SetAPB1Prescaler(LL_RCC_APB1_DIV_1);
    LL_RCC_SetAPB2Prescaler(LL_RCC_APB2_DIV_1);
    LL_RCC_SetSysClkSource(LL_RCC_SYS_CLKSOURCE_PLL);

    /* Wait till System clock is ready */
    while (LL_RCC_GetSysClkSource() != LL_RCC_SYS_CLKSOURCE_STATUS_PLL)
    {
    }
    LL_Init1msTick(36000000);
    LL_SetSystemCoreClock(36000000);
}

/* USER CODE BEGIN 4 */
void runApp()
{

    if (((*(__IO uint32_t *)APP_ADDR) & 0x2ffe0000) == 0x20000000)
    {
        p_APP application;
        uint32_t jump_address;
        jump_address = *(__IO uint32_t *)(APP_ADDR + 4);
        application = (p_APP)jump_address;
        __disable_irq();

        /* Force reset  */
        LL_APB1_GRP1_ForceReset(LL_APB1_GRP1_PERIPH_USART2 | LL_APB1_GRP1_PERIPH_USART3);
        LL_APB2_GRP1_ForceReset(LL_APB2_GRP1_PERIPH_GPIOA | LL_APB2_GRP1_PERIPH_GPIOB | LL_APB2_GRP1_PERIPH_USART1);
        LL_APB1_GRP1_ReleaseReset(LL_APB1_GRP1_PERIPH_USART2 | LL_APB1_GRP1_PERIPH_USART3);
        LL_APB2_GRP1_ReleaseReset(LL_APB2_GRP1_PERIPH_GPIOA | LL_APB2_GRP1_PERIPH_GPIOB | LL_APB2_GRP1_PERIPH_USART1);
        SysTick->CTRL = 0;
        SysTick->LOAD = 0;
        SysTick->VAL = 0;

        SCB->VTOR = APP_ADDR;
        __set_MSP(*(__IO uint32_t *)APP_ADDR);

        application();
    }
}

uint8_t getch(void)
{
    while ((*G_SR & USART_SR_RXNE) == 0)
        ;
    return *G_DR;
}

void putch(uint8_t byte)
{
    *P_DR = byte;
    while ((*P_SR & USART_SR_TXE) == 0)
        ;
}

uint32_t verifySpace(void)
{
    if (getch() == CRC_EOP)
    {
        putch(STK_INSYNC);
        return 0;
    }

    return 1;
}

void bgetNch(uint32_t count)
{
    do
    {
        getch();
    } while (--count);
}

void system_init(void)
{
    GPIOA->CRH = (GPIOA->CRH & 0xFFFFFF0F) | 0x00000090; // PA9
    // USART2 RX is PA3, only Rx used
    // USART3 TX is PB10, only Tx used
    GPIOB->CRH = (GPIOB->CRH & 0xFFFFF0FF) | 0x00000900; // PB10

    GPIOB->CRL = (GPIOB->CRL & 0xFFFF0F0F) | 0x00002020; // PB1 and PB3, invert controls

    GPIOB->BRR = 0x00000008;
    GPIOB->BSRR = 0x00000002;

    GPIOA->BSRR = 0x000000F1;
    GPIOA->CRL = (GPIOA->CRL & 0x0000FF00) | 0x88880028; // LED and inputs

#ifdef DEBUG
    USART1->BRR = 36000000 / 57600;
    USART1->CR1 = 0x200C;
#endif

    USART2->BRR = 36000000 / 57600;
    USART2->CR1 = 0x200C;
    //    USART2->CR2 = 0;
    //    USART2->CR3 = 0;
    USART3->BRR = 36000000 / 57600;
    USART3->CR1 = 0x200C;
    //    USART3->CR2 = 0;
    //    USART3->CR3 = 0;
}

/* USER CODE END 4 */

void Error_Handler(void)
{
    __disable_irq();
    while (1)
    {
    }
}
